## Kconfig
```kconfig
config TOTEM_ADV_THROTTLE
	bool "Stop host advertising after the selected host has been away"
	depends on ZMK_BLE && ZMK_SPLIT_ROLE_CENTRAL
	default n
	help
	  After CONFIG_TOTEM_ADV_THROTTLE_TIMEOUT_MIN minutes with the active
	  profile disconnected, stop BLE advertising (split scan is unchanged).
	  A keypress on the central kicks advertising again via profile select.

config TOTEM_ADV_THROTTLE_TIMEOUT_MIN
	int "Minutes before advertising stops when the host is away"
	depends on TOTEM_ADV_THROTTLE
	default 5
	range 1 120
```
